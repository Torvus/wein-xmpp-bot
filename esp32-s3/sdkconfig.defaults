## esp32-s3/sdkconfig.defaults
```kconfig
CONFIG_BT_ENABLED=y
CONFIG_BT_NIMBLE_ENABLED=y
CONFIG_BT_NIMBLE_ROLE_CENTRAL=y
CONFIG_BT_NIMBLE_ROLE_PERIPHERAL=n
CONFIG_BT_NIMBLE_ROLE_BROADCASTER=n
CONFIG_BT_NIMBLE_ROLE_OBSERVER=y
CONFIG_BT_NIMBLE_MAX_CONNECTIONS=1
CONFIG_BT_NIMBLE_PINNED_TO_CORE=0
CONFIG_BT_NIMBLE_HOST_TASK_STACK_SIZE=4096
CONFIG_BT_NIMBLE_SM_LEGACY=y
CONFIG_BT_NIMBLE_SM_SC=y
CONFIG_BT_NIMBLE_SM_BONDING=y
CONFIG_BT_NIMBLE_STORE_CONFIG_PERSIST=y

CONFIG_ESP_WIFI_ENABLED=y
CONFIG_ESP_WIFI_STA_DISCONNECTED_PM_ENABLE=n

CONFIG_MQTT_PROTOCOL_311=y
CONFIG_MQTT_PROTOCOL_5=y
CONFIG_MBEDTLS_CERTIFICATE_BUNDLE=y

CONFIG_ESPTOOLPY_FLASHSIZE_8MB=y
```
